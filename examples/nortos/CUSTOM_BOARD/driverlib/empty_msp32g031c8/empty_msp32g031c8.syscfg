/**
 * These arguments were used when this file was generated. They will be automatically applied on subsequent loads
 * via the GUI or CLI. Run CLI with '--help' for additional information on how to override these arguments.
 */
//@cliArgs --device "MSP32G031CX" --package "LQFP-48(PT-ST)" --part "Default"
//@v2CliArgs --device "MSPM0C1106" --package "LQFP-48(PT-ST)" --variant "MSP32G031C8"

/**
 * Import the modules used in this configuration.
 */
const SYSCTL = scripting.addModule("/ti/driverlib/SYSCTL");
const ProjectConfig = scripting.addModule("/ti/project_config/ProjectConfig");

/**
 * Write custom configuration values to the imported modules.
 */

const Board = scripting.addModule("/ti/driverlib/Board", {}, false);

ProjectConfig.deviceSpin = "MSPM0C1106";
